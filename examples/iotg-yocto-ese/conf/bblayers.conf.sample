## examples/iotg-yocto-ese/conf/bblayers.conf.sample
```bitbake
# POKY_BBLAYERS_CONF_VERSION is increased each time build/conf/bblayers.conf
# changes incompatibly
POKY_BBLAYERS_CONF_VERSION = "2"

BBPATH = "${TOPDIR}"
BBFILES ?= ""

BBLAYERS ?= "\
  ${TOPDIR}/../openembedded-core/meta \
  ${TOPDIR}/../meta-openembedded/meta-oe \
  ${TOPDIR}/../meta-openembedded/meta-filesystems \
  ${TOPDIR}/../meta-openembedded/meta-perl \
  ${TOPDIR}/../meta-openembedded/meta-python \
  ${TOPDIR}/../meta-openembedded/meta-networking \
  ${TOPDIR}/../meta-intel \
  ${TOPDIR}/../iotg-yocto-ese-bsp \
  ${TOPDIR}/../iotg-yocto-ese \
  ${TOPDIR}/../iotg-yocto-ese-main \
  ${TOPDIR}/../../.. \
"
```
